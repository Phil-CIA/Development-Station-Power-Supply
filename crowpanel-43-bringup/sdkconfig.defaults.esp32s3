## crowpanel-43-bringup/sdkconfig.defaults.esp32s3
```kconfig
# Enable PSRAM at 120MHz in octal SPI mode (AP_3v3 chip on CrowPanel V1.2)
CONFIG_SPIRAM=y
CONFIG_SPIRAM_MODE_OCT=y
CONFIG_IDF_EXPERIMENTAL_FEATURES=y
CONFIG_SPIRAM_SPEED_120M=y
# KEY FIX: allows ISR handlers to reside in PSRAM instead of IRAM,
# freeing the last IRAM_SAFE interrupt slot for LCD_CAM.
CONFIG_SPIRAM_FETCH_INSTRUCTIONS=y
CONFIG_SPIRAM_RODATA=y

# Improve RGB panel PCLK when framebuffer is in PSRAM (EDMA path)
CONFIG_FREERTOS_HZ=1000
CONFIG_ESP_DEFAULT_CPU_FREQ_MHZ_240=y
CONFIG_ESPTOOLPY_FLASHMODE_QIO=y
CONFIG_ESPTOOLPY_FLASHFREQ_80M=y
CONFIG_ESPTOOLPY_FLASHSIZE_16MB=y
CONFIG_ESP32S3_DATA_CACHE_LINE_32B=y
CONFIG_COMPILER_OPTIMIZATION_PERF=y

# Custom partition table
CONFIG_PARTITION_TABLE_CUSTOM=y
CONFIG_PARTITION_TABLE_CUSTOM_FILENAME="partitions.csv"
CONFIG_PARTITION_TABLE_FILENAME="partitions.csv"
```
